## conf/layer.conf
```bitbake
# We have a conf and classes directory, append to BBPATH
BBPATH .= ":${LAYERDIR}"

# We have a recipes directory, add to BBFILES
BBFILES += "${LAYERDIR}/recipes*/*/*.bb ${LAYERDIR}/recipes*/*/*.bbappend"

BBFILE_COLLECTIONS += "meta-sinux"
BBFILE_PATTERN_meta-sinux := "^${LAYERDIR}/"
BBFILE_PRIORITY_meta-sinux = "10"
LAYERSERIES_COMPAT_meta-sinux = "dunfell"
```
